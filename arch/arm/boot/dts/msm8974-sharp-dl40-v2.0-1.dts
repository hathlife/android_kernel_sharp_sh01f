/* Copyright (c) 2013, The Linux Foundation. All rights reserved.
 *
 * This program is free software; you can redistribute it and/or modify
 * it under the terms of the GNU General Public License version 2 and
 * only version 2 as published by the Free Software Foundation.
 *
 * This program is distributed in the hope that it will be useful,
 * but WITHOUT ANY WARRANTY; without even the implied warranty of
 * MERCHANTABILITY or FITNESS FOR A PARTICULAR PURPOSE.  See the
 * GNU General Public License for more details.
 */

/dts-v1/;

/include/ "msm8974-v2.0-1.dtsi"
/include/ "sharp-common.dtsi"
/include/ "sharp-common-v2.0-1.dtsi"
/include/ "sharp-dl40.dtsi"

/ {
	model = "sharp dl40 v2.0/1";
	compatible = "qcom,sharp-dl40", "qcom,msm8974-cdp", "qcom,msm8974", "qcom,cdp";
	qcom,msm-id = <126 31 0x20000>,
		      <185 31 0x20000>,
		      <186 31 0x20000>;
};
